## build-rpi4/conf/bblayers.conf
```bitbake
# POKY_BBLAYERS_CONF_VERSION is increased each time build/conf/bblayers.conf
# changes incompatibly
POKY_BBLAYERS_CONF_VERSION = "2"

BBPATH = "${TOPDIR}"
BBFILES ?= ""

BBLAYERS ?= " \
  /home/yoctouser/yocto_projects/poky/meta \
  /home/yoctouser/yocto_projects/poky/meta-poky \
  /home/yoctouser/PocoYocto/metas/meta-raspberrypi \
  /home/yoctouser/PocoYocto/metas-propias/meta-raspberrypi4-64-custom \
  "
```

## build-rpi4/conf/local.conf
```bitbake
MACHINE = "raspberrypi4-64"
DISTRO = "poky"

# Enable SSH and Wi-Fi
IMAGE_FEATURES += "ssh-server-openssh"
IMAGE_INSTALL:append = " wpa-supplicant wireless-tools wpa-supplicant-config"

# Clean up work directory after each recipe is built
INHERIT += "rm_work"

# Specify where to find the custom layer
BBPATH .= ":${TOPDIR}/../metas-propias/meta-raspberrypi4-64-custom"

# Package management
PACKAGE_CLASSES = "package_rpm"

# Connect to the internet
CONNECTIVITY_CHECK_URIS = "https://www.google.com/"

#parallelism options
BB_NUMBER_THREADS = "4"
PARALLEL_MAKE = "-j 4"

# Set the path to the download directory
DL_DIR = "${TOPDIR}/../downloads"

# Set the path to the sstate cache directory
SSTATE_DIR = "${TOPDIR}/../sstate-cache"

# Set the path to the cache directory
CACHE = "${TOPDIR}/../cache"

# Add license for wpa_supplicant
LICENSE_FLAGS_ACCEPTED = "commercial"
```

## metas-propias/meta-mini/conf/bblayers.conf.sample
```bitbake
# POKY-LAYER SETUP - OMITTED FOR BREVITY
POKY_BBLAYERS_CONF_VERSION = "2"
BBPATH = "${TOPDIR}"
BBFILES ?= ""
BBLAYERS ?= " \
  ${TOPDIR}/../poky/meta \
  ${TOPDIR}/../poky/meta-poky \
  ${TOPDIR}/../poky/meta-yocto-bsp \
  ${TOPDIR}/../metas/meta-openembedded/meta-oe \
  ${TOPDIR}/../metas/meta-openembedded/meta-multimedia \
  ${TOPDIR}/../metas/meta-openembedded/meta-networking \
  ${TOPDIR}/../metas/meta-openembedded/meta-python \
  ${TOPDIR}/../metas-propias/meta-raspberrypi \
  ${TOPDIR}/../metas-propias/meta-mini \
  "
```

## metas-propias/meta-raspberrypi4-64-custom/conf/layer.conf
```bitbake
# We have a conf and classes directory, add to BBPATH
BBPATH .= ":${LAYERDIR}"

# We have recipes-* directories, add to BBFILES
BBFILES += "${LAYERDIR}/recipes-*/*/*.bb \
            ${LAYERDIR}/recipes-*/*/*.bbappend"

BBFILE_COLLECTIONS += "meta-raspberrypi4-64-custom"
BBFILE_PATTERN_meta-raspberrypi4-64-custom = "^${LAYERDIR}/"
BBFILE_PRIORITY_meta-raspberrypi4-64-custom = "6"

LAYERDEPENDS_meta-raspberrypi4-64-custom = "core"

LAYERSERIES_COMPAT_meta-raspberrypi4-64-custom = "kirkstone"
```

## metas-propias/meta-rpi-custom/conf/layer.conf
```bitbake
# We have a conf and classes directory, add to BBPATH
BBPATH .= ":${LAYERDIR}"

# We have recipes-* directories, add to BBFILES
BBFILES += "${LAYERDIR}/recipes-*/*/*.bb \
            ${LAYERDIR}/recipes-*/*/*.bbappend"

BBFILE_COLLECTIONS += "rpi-custom"
BBFILE_PATTERN_rpi-custom = "^${LAYERDIR}/"
BBFILE_PRIORITY_rpi-custom = "10"

LAYERDEPENDS_rpi-custom = "core"

LAYERSERIES_COMPAT_rpi-custom = "kirkstone"
```
